## sdkconfig.defaults
```kconfig
CONFIG_ESP_MAIN_TASK_STACK_SIZE=3000
CONFIG_FREERTOS_UNICORE=y
CONFIG_ESP_TASK_WDT=n
CONFIG_ESPTOOLPY_FLASHSIZE_4MB=y
CONFIG_ESP32_DEFAULT_CPU_FREQ_240=y
CONFIG_ESP_WIFI_SSID="TP-LINK_AP_8670"
CONFIG_ESP_WIFI_PASSWORD="17Defer2TheMaster"
CONFIG_MICRO_ROS_AGENT_IP="192.168.2.28"
CONFIG_MICRO_ROS_AGENT_PORT="8888"
```
